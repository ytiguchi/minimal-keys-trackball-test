## config/boards/shields/minimal-keys/Kconfig.defconfig
```kconfig
if SHIELD_MINIMAL_KEYS_R

config ZMK_KEYBOARD_NAME
    default "minimal-keys_R"

config ZMK_SPLIT
    default y

config ZMK_SPLIT_ROLE_CENTRAL
    default y

endif

if SHIELD_MINIMAL_KEYS_L

config ZMK_KEYBOARD_NAME
    default "minimal-keys_L"

config ZMK_SPLIT
    default y

endif

if SHIELD_MINIMAL_KEYS_L_CENTRAL_TEST

config ZMK_KEYBOARD_NAME
    default "minimal-keys_L_test"

config ZMK_SPLIT
    default y

config ZMK_SPLIT_ROLE_CENTRAL
    default y

endif
```

## config/boards/shields/minimal-keys/Kconfig.shield
```kconfig
config SHIELD_MINIMAL_KEYS_R
    def_bool $(shields_list_contains,minimal-keys_R)

config SHIELD_MINIMAL_KEYS_L
    def_bool $(shields_list_contains,minimal-keys_L)

config SHIELD_MINIMAL_KEYS_L_CENTRAL_TEST
    def_bool $(shields_list_contains,minimal-keys_L_central_test)
```
